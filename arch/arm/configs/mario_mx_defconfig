## drivers/input/haptic/Kconfig
```kconfig
#
# Haptic device driver configuration
#
config INPUT_HAPTIC
	tristate "Haptic device driver"
	depends on INPUT
	help
	  Say Y here if you have a haptic device connected to your system.

	  If unsure, say N.

	  To compile this driver as a module, choose M here: the
	  module will be called haptic.
```

## drivers/input/keyboard/fiona_legacy/Kconfig
```kconfig
#
# Codec configuration
#

menu "Fiona Legacy Keyboard support"

config FIONA_LEGACY_KBD
	  tristate "Support for Fiona Legacy Keyboard"
	  depends on KEYBOARD_MXC
	  default y
	---help---
	  The Fiona Legacy Keyboard driver

config FIONA_LEGACY_KBD_DEBUG
	bool "Fiona Legacy Keyboard Debugging"
	depends on FIONA_LEGACY_KBD != n
	help
	  This is an option for the developers; most people should
	  say N here.  This enables Fiona Legacy driver debugging.

endmenu
```

## drivers/input/mag_sensor/Kconfig
```kconfig
#
# Magnetic sensor driver configuration
#
config INPUT_MAG_SENSOR
	tristate "Magnetic Sensor"
	depends on INPUT
	help
	  Say Y here if you have a magnetic sensor installed in your system.

	  If unsure, say N.

	  To compile this driver as a module, choose M here: the
	  module will be called mag_sensor.
```

## drivers/input/trackball/Kconfig
```kconfig
#
# Trackball driver configuration
#
config INPUT_TRACKBALL
	tristate "Trackball"
	depends on INPUT
	help
	  Say Y here if you have a trackball connected to your system.

	  If unsure, say N.

	  To compile this driver as a module, choose M here: the
	  module will be called trackball.
```

## drivers/mmc/core/Kconfig
```kconfig
#
# MMC core configuration
#

config MMC_UNSAFE_RESUME
	bool "Allow unsafe resume (DANGEROUS)"
	help
	  If you say Y here, the MMC layer will assume that all cards
	  stayed in their respective slots during the suspend. The
	  normal behaviour is to remove them at suspend and
	  redetecting them at resume. Breaking this assumption will
	  in most cases result in data corruption.

	  This option is usually just for embedded systems which use
	  a MMC/SD card for rootfs. Most people should say N here.

config MMC_DETECT_SYNC
	bool "Synchronous MMC detection processing"
	depends on MACH_LAB126
	default y
	help
	  This selects whether or not to have MMC card detection processing
	  operate in a synchronous fashion for non-IRQ-based card insertion
	  events.  This must be enabled for Mario MoviNAND-based platforms.
```

## drivers/mxc/charger/Kconfig
```kconfig
#
# Battery charger driver
#

menu "Battery Charger driver"

config MXC_CHARGER
	tristate "MXC Battery Charger driver"
	depends on MXC_PMIC_MC13783
	depends on MXC_BATTERY
	default m
	help
	   This selects the battery charger driver that controls the
	   Freescale MC13783.

	   Say Y to compile it into the kernel.

	   If unsure, say N.

	   To compile this driver as a module, choose M here:
	   the module will be called "charger".

config MXC_BATTERY
	tristate "MXC Battery Communication driver"
	depends on MXC_PMIC_MC13783
	default m
	help
	   This selects the I2C client driver that communicates with
	   the battery over I2C.

	   Say Y to compile it into the kernel.

	   If unsure, say N.

	   To compile this driver as a module, choose M here:
	   the module will be called "battery".

endmenu
```

## drivers/video/eink/Kconfig
```kconfig
#
# eInk configuration
#

config FB_EINK_LIBRARY
    bool "eInk Built-in Library"
    select FB_CFB_FILLRECT
    select FB_CFB_COPYAREA
    select FB_CFB_IMAGEBLIT
	select FB_SYS_FILLRECT
	select FB_SYS_COPYAREA
	select FB_SYS_IMAGEBLIT
	select FB_SYS_FOPS
    select ZLIB_INFLATE
    select ZLIB_DEFLATE
    select PROC_BOOTDATA
    default y

config FB_EINK
    tristate "eInk Umbrella Config (HAL & Legacy Shim)"
    depends on FB

config FB_EINK_LEGACY
	tristate "eInk Legacy Config for Shim"
	depends on FB_EINK

config FB_EINK_SHIM
    tristate "eink Shim Driver (Legacy-to-HAL Bridge)"
    depends on FB_EINK
    
config FB_EINK_HAL
    tristate "eink HAL Umbrella Config"
    depends on FB_EINK

config FB_EINK_HAL_EMULATOR
    tristate "eInk HAL Driver for the Emulator"
    depends on FB_EINK_HAL
    
config FB_EINK_HAL_BROADSHEET
    tristate "eInk HAL Driver for the Broadsheet Controller"
    depends on FB_EINK_HAL && ARCH_MXC

config FB_EINK_HAL_AUO
    tristate "eInk HAL Driver for the AUO Controller"
    depends on FB_EINK_HAL && ARCH_MXC
    default no

#
# only for testing!
#

config FB_EINK_HAL_BUILTIN
    bool "Built-in eink HAL Umbrella Config"
    depends on FB

config FB_EINK_HAL_BUILTIN_EM
    bool "Built-in eInk HAL Driver for the Emulator"
    depends on FB_EINK_HAL_BUILTIN

config FB_EINK_HAL_BUILTIN_BS
    bool "Built-in eInk HAL Driver for the Broadsheet Controller"
    depends on FB_EINK_HAL_BUILTIN
```
